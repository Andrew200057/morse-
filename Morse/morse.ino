#include <Morse.h>

Morse morse(13);//定义莫尔斯电码表
char Morse[][4] = 
{
  {'.', '-', '*', '*'}, //A
  {'-', '.', '.', '.'}, //B
  {'-', '.', '-', '.'}, //C
  {'-', '.', '.', '*'}, //D
  {'.', '*', '*', '*'}, //E
  {'.', '.', '-', '.'}, //F
  {'-', '-', '.', '*'}, //G
  {'.', '.', '.', '.'}, //H
  {'.', '.', '*', '*'}, //I
  {'.', '-', '-', '-'}, //J
  {'-', '.', '-', '*'}, //K
  {'.', '-', '.', '.'}, //L
  {'-', '-', '*', '*'}, //M
  {'-', '.', '*', '*'}, //N
  {'-', '-', '-', '*'}, //O
  {'.', '-', '-', '.'}, //P
  {'-', '-', '.', '-'}, //Q
  {'.', '-', '.', '*'}, //R
  {'.', '.', '.', '*'}, //S
  {'-', '*', '*', '*'}, //T
  {'.', '.', '-', '*'}, //U
  {'.', '.', '.', '-'}, //V
  {'.', '-', '-', '*'}, //W
  {'-', '.', '.', '-'}, //X
  {'-', '.', '-', '-'}, //Y
  {'-', '-', '.', '.'}  //Z
};

void setup()
{
  Serial.begin(9600);//设通信频率为9600
}

void loop()
{
  String str = "";  //定义未转义字符串
  String morse_s = "";  //定义转义后字符串
  int i, t , temp = 0;
  int n = 0;  //对传入个数计数
  while (Serial.available() > 0)
  {
    temp = 1;  //判断是否有数据传入
    str += char(Serial.read());  //将传入的数据储存在字符串中
    delay(2);  //设延迟为2
    n++;
  }

  if (temp)  //如果有数据输入则进行查询和转换
  {
    for (i = 0; i < n; i++)  //查询Morse电码表
    {
      for (t = 0; t < 4; t++)
      {
        if (str[i] >= 97 && str[i] <= 122)  //判断是否为小写字母，如果是则转义
        {
          morse_s += char(Morse[int(str[i] - 97)][t]);
        }
      }
      morse_s += ' ';  //每段Morse之后补空格
    }
    Serial.println(morse_s);  //串口传入
    for (i = 0; morse_s[i]!='\0' ; i++)  //读取Morse电码
    {
      if (morse_s[i] == '.')morse.dot();
        else if (morse_s[i] == '-')morse.dash();
          else if (morse_s[i] == ' ')morse.w_space();
      if (morse_s[i] != ' ' && str[i] != '*')morse.c_space();
    }
    Serial.println("发送完毕");
    delay(2);
  }
}
